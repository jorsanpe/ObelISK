## obelisk/Kconfig
```kconfig
# ObelISK configuration

mainmenu "ObelISK Configuration Tool"

choice
	prompt "Architecture"
	default ARCH_BLACKFIN
config ARCH_BLACKFIN
	bool "Blackfin Architecture"
	help
		Choose this to run ObelISK on a Blackfin DSP
endchoice

# architecture specific devices
if ARCH_BLACKFIN
menu "Architecture specific"
source "core/kernel/blackfin/Kconfig"
endmenu
menu "Boot Loader"
source "user/bootloader/Kconfig"
endmenu
endif

menu "ObelISK core configuration"
source "core/Kconfig"
endmenu

menu "Device Drivers"
source "drivers/Kconfig"
endmenu
```

## obelisk/core/Kconfig
```kconfig
menu "Object Pools"
config MAX_TASKS
	int "Task Pool Size"
	default 5
	help
		Maximum number of tasks allocatable
config MAX_SEM
	int "Semaphore Pool Size"
	default 1
	help
		Maximum number of semaphores allocatable
config MAX_EVENT
	int "Eventflag Pool size"
	default 1
	help
		Maximum number of eventflags allocatable
config MAX_MAILBOX
	int "Mailbox Pool size"
	default 1
	help
		Maximum number of mailboxes allocatable
config MAX_MAILBOX_MSG
	int "Mailbox Messages Pool size"
	default 128
	help
		Maximum number of mailbox messages
config MAX_FMPOOL
	int "Fixed-Size Memory Pools"
	default 0
	help
		Maximum number of memory pools serving fixed-size blocks on the system
config MAX_VMPOOL
	int "Variable-Size Memory Pools"
	default 4
	help
		Maximum number of memory pools serving variable-size blocks on the system
endmenu
config SYSLOG_ACTIVE
	bool "Activate System Log"
	default y
if SYSLOG_ACTIVE
config SYSLOG_SIZE
	int "System Log size"
	default 128
endif
config KSTACK_SIZE
	int "Task Kernel Stack Area Size"
	default 1024
	help
		Each task has a stack area for kernel use
```

## obelisk/core/kernel/blackfin/Kconfig
```kconfig
#
# Plug and Play configuration
#

choice 
	prompt "Blackfin CPU"
	default CPU_BF548
config CPU_BF548
	bool "BF548"
	help 
		At this point this is the only CPU supported
endchoice
config CLKIN
	int "Clock Input Frequency (Hz)"
	default 25000000
config CCLK
	int "Core Clock Frequency (Hz)"
	default 500000000
config SCLK
	int "System Clock Frequency (Hz)"
	default 125000000
config CTMR
	int "Core Timer Period (us)"
	default 1000
config RAM_SIZE
	int "External Memory Size (MB)"
	default 64
config BFIN_ICACHE
	bool "Enable Instruction Cache"
config BFIN_DCACHE
	bool "Enable Data Cache Bank A"
if BFIN_DCACHE
config BFIN_DCACHEB
	bool "Enable Data Cache Bank B"
choice
	prompt "Caching Method"
	default BFIN_WT
config BFIN_WT
	bool "Write Through"
config BFIN_WB
	bool "Write Back"
endchoice
endif
	
```

## obelisk/drivers/Kconfig
```kconfig
config MAX_DEVICES
	int "Device Pool size"
	default 5
	help
		Maximum number of devices that can be opened at once
config MAX_DEVICE_REQUESTS
	int "Device Request Pool size"
	default 20
	help
		Each read and write to a device generates a request. Set here the maximum number of requests on the system
		
menu "lwIP Settings"
source "drivers/lwip/Kconfig"
endmenu

config ISFLASH
	bool "Intel Strata Flash Driver"
	default n
	help
		Compile Intel Strata Flash Driver

menu "Integrated Camera"
source "drivers/camera/Kconfig"
endmenu
	
config BFCAN
	bool "Blackfin CAN Driver"
	default n
	help
		Compile Blackfin CAN driver
```

## obelisk/drivers/camera/Kconfig
```kconfig
choice
	prompt "Camera Chipset"
	default OV7660
config OV7660
	bool "Omnivision OV7660 Camera Driver"
	help
		Compile OV7660 camera driver
endchoice
choice
	prompt "Camera Mode"
	default OV7660_CCIR656_VGA_YUV_15FPS
config OV7660_CCIR656_VGA_YUV_15FPS
	bool "VGA 640x480, YUV, 15 FPS"
	help
		Using CCIR656
config OV7660_CCIR656_QVGA_YUV_15FPS
	bool "QVGA 320x240, YUV, 15 FPS"
	help
		Using CCIR656
endchoice
	
```

## obelisk/drivers/lwip/Kconfig
```kconfig
config USING_LWIP
	bool "Enable lwIP TCP/IP Stack"
	default 0
	
if USING_LWIP

choice
	prompt "lwIP Features"
	default LWIP_SOCKET_API
config LWIP_MINIMAL_FEATURES
	bool "Minimal Features"
config LWIP_SEQUENTIAL_API
	bool "Sequential API"
config LWIP_SOCKET_API
	bool "Socket API"
endchoice

config ETHIF_PRIO
	int "Ethernet Thread Piority"
	default 5

menu "Configure Network"
config USE_DHCP
	bool "Activate DHCP"
	default 0
	
if !USE_DHCP
config IP_ADDRESS
	string "IP Address"
	default "192.168.1.1"
config NETMASK
	string "Network Mask"
	default "255.255.255.0"
config GATEWAY
	string "Default Gateway"
	default "192.168.1.0"
config MAC_ADDRESS
	string "MAC Address"
	default "EE:FF:C0:A8:01:01"
endif

endmenu

endif
```

## obelisk/user/bootloader/Kconfig
```kconfig
#
# Flash Boot Configuration
#

config FLASH_SIZE
	int "Flash Memory Size (B)"
	default 8000000
config FLASH_START_ADDRESS
	hex "Flash Start Address"
	default 0x20000000
config APPLICATION_OFFSET
	hex "Applications on flash start address"
	default 0x1000
	
```
